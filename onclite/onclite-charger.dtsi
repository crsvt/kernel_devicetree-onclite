/* SPDX-License-Identifier: GPL-2.0-only */

&pmi632_charger {
	qcom,float-option = <1>;
	qcom,auto-recharge-soc = <99>;
	qcom,hvdcp-disable;
	qcom,micro-usb;
	qcom,sw-jeita-enable = <1>;
	qcom,fcc-max-ua = <2000000>;
	qcom,usb-icl-ua = <3000000>;
	qcom,fv-max-uv = <4400000>;
	qcom,chg-term-src = <1>;
	qcom,chg-term-current-ma = <(-200)>;
	qcom,thermal-mitigation = <2000000 1500000 1000000 800000 500000 200000>;
};

&pmi632_qg {
	qcom,vbatt-empty-mv = <2900>;
	qcom,vbatt-empty-cold-mv = <3000>;
	qcom,vbatt-low-mv = <3600>;
	qcom,vbatt-cutoff-mv = <3500>;
	qcom,qg-iterm-ma = <330>;
	qcom,ignore-shutdown-soc-secs = <1800>;
	qcom,shutdown-soc-threshold = <40>;
};

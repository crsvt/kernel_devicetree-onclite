/* SPDX-License-Identifier: GPL-2.0-only */

/* pm8953_l6: 1.8V VIO — always-on (touch, camera, fingerprint) */
&pm8953_l6 {
	regulator-always-on;
};

/* pm8953_l10: 2.8V touch VDD */
&pm8953_l10 {
	regulator-min-microvolt = <2800000>;
	regulator-max-microvolt = <2800000>;
	qcom,init-voltage = <2800000>;
	regulator-always-on;
};

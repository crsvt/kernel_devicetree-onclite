/* SPDX-License-Identifier: GPL-2.0-only */

&other_ext_mem {
	reg = <0x0 0x84A00000 0x0 0x1E00000>;
};

&adsp_fw_mem {
	reg = <0x0 0x8d600000 0x0 0x1400000>;
};

&wcnss_fw_mem {
	reg = <0x0 0x8ea00000 0x0 0x700000>;
};

&dump_mem {
	size = <0x0 0x400000>;
};
